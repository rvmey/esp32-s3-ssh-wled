/*
 * screen_control_core2.c
 *
 * ILI9342C SPI display driver for the M5Stack Core2 for AWS (320 x 240).
 * Implements the screen_control.h API so picture_frame.c can be shared
 * between the JC3248W535 and Core2 variants without modification.
 *
 * Hardware wiring (M5Stack Core2)
 * ─────────────────────────────────
 *   ILI9342C SPI     MOSI=GPIO23  MISO=GPIO38  SCK=GPIO18  CS=GPIO5  DC=GPIO15
 *   AXP192 PMU       I2C addr 0x34 on SDA=GPIO21 / SCL=GPIO22
 *   FT6336U touch    I2C addr 0x38 on the same bus
 *
 * Orientation
 * ───────────
 *   Physical panel is 320×240 (landscape native).
 *   s_landscape=true  → landscape 320×240 (default for Core2)
 *   s_landscape=false → portrait  240×320 (software-rotated 90° CW)
 *
 * NOTE: MADCTL colour-order byte may need tuning (0x48 vs 0x08 etc.)
 * if the image appears mirrored or has swapped red/blue channels on
 * a specific panel batch.  See MADCTL_LANDSCAPE below.
 */

#include "screen_control.h"

#include "driver/spi_master.h"
#include "driver/gpio.h"
#include "driver/i2c.h"
#include "esp_log.h"
#include "freertos/FreeRTOS.h"
#include "freertos/task.h"
#include "freertos/semphr.h"
#include <stdbool.h>
#include <string.h>

static const char *TAG = "screen_c2";

/* ------------------------------------------------------------------ */
/* Hardware constants (M5Stack Core2)                                 */
/* ------------------------------------------------------------------ */

#define LCD_HOST     SPI2_HOST
/* ESP32 SPI master on this setup rejects >26.666MHz for the LCD device. */
#define LCD_CLK_HZ   (26 * 1000 * 1000)

#define LCD_MOSI     23
#define LCD_MISO     38
#define LCD_CLK      18
#define LCD_CS        5
#define LCD_DC       15

#define LCD_PHYS_W   320   /* panel physical width  (native landscape) */
#define LCD_PHYS_H   240   /* panel physical height (native landscape) */
#define LCD_MAX_DIM  320   /* longest physical dimension, for row-buf   */

/*
 * MADCTL value for native landscape orientation (MX=1, BGR=1).
 * If colours appear swapped (red ↔ blue), clear the BGR bit (0x48→0x40).
 * If image is horizontally mirrored, try 0x08 (BGR only, no MX).
 */
#define MADCTL_LANDSCAPE  0x48   /* MX | BGR */

/* ------------------------------------------------------------------ */
/* AXP192 PMU (I2C 0x34 on GPIO21/22)                                 */
/* ------------------------------------------------------------------ */

#define AXP_I2C_NUM   I2C_NUM_0
#define AXP_I2C_ADDR  0x34
#define I2C_SDA_GPIO  21
#define I2C_SCL_GPIO  22

/* ------------------------------------------------------------------ */
/* FT6336U touch controller (I2C 0x38 on the same bus)                */
/* ------------------------------------------------------------------ */

#define TOUCH_I2C_ADDR  0x38

/* ------------------------------------------------------------------ */
/* Module state                                                        */
/* ------------------------------------------------------------------ */

static spi_device_handle_t s_spi         = NULL;
static uint8_t             s_r, s_g, s_b;
static uint8_t             s_fr = 0xFF, s_fg = 0xFF, s_fb = 0xFF;
static bool                s_landscape   = true;  /* default: landscape */
static int                 s_font_scale  = 2;
static char                s_text[512];

static int               s_scroll_line  = 0;
static int               s_scroll_total = 0;

static SemaphoreHandle_t s_draw_mutex   = NULL;

/* Logical width/height — NOTE: landscape is the native/default orientation */
static inline int lcd_w(void) { return s_landscape ? LCD_PHYS_W : LCD_PHYS_H; }
static inline int lcd_h(void) { return s_landscape ? LCD_PHYS_H : LCD_PHYS_W; }

/* Row buffer — one physical row = 320 × 2 bytes */
static uint8_t s_row_buf[LCD_MAX_DIM * 2];

/* Forward declaration */
static void touch_poll_task(void *arg);

/* ------------------------------------------------------------------ */
/* AXP192 I2C helpers                                                 */
/* ------------------------------------------------------------------ */

static esp_err_t axp_write(uint8_t reg, uint8_t val)
{
    uint8_t buf[2] = { reg, val };
    return i2c_master_write_to_device(AXP_I2C_NUM, AXP_I2C_ADDR,
                                      buf, 2, pdMS_TO_TICKS(50));
}
static esp_err_t axp_read(uint8_t reg, uint8_t *val)
{
    return i2c_master_write_read_device(
        AXP_I2C_NUM, AXP_I2C_ADDR, &reg, 1, val, 1, pdMS_TO_TICKS(20));
}

static esp_err_t axp_read_modify_write(uint8_t reg, uint8_t mask, uint8_t set)
{
    uint8_t val = 0;
    i2c_master_write_read_device(AXP_I2C_NUM, AXP_I2C_ADDR,
                                 &reg, 1, &val, 1, pdMS_TO_TICKS(50));
    val = (val & ~mask) | (set & mask);
    return axp_write(reg, val);
}

/* ------------------------------------------------------------------ */
/* Low-level ILI9342C SPI helpers                                     */
/* ------------------------------------------------------------------ */

/* Pre-transfer callback: set DC pin according to transaction user field */
static void IRAM_ATTR ili_pre_cb(spi_transaction_t *t)
{
    gpio_set_level(LCD_DC, (int)(intptr_t)t->user);
}

/* Send one command byte (DC=0) */
static void ili_cmd(uint8_t cmd)
{
    spi_transaction_t t = {
        .length    = 8,
        .tx_buffer = &cmd,
        .user      = (void *)0,   /* DC = 0 */
    };
    ESP_ERROR_CHECK(spi_device_polling_transmit(s_spi, &t));
}

/* Send data bytes (DC=1); len must be > 0 */
static void ili_data(const uint8_t *data, size_t len)
{
    spi_transaction_t t = {
        .length    = len * 8,
        .tx_buffer = data,
        .user      = (void *)1,   /* DC = 1 */
    };
    ESP_ERROR_CHECK(spi_device_polling_transmit(s_spi, &t));
}

/* Send a single data byte (DC=1) */
static void ili_data_byte(uint8_t b)
{
    ili_data(&b, 1);
}

/* Set the GRAM address window */
static void ili_set_window(uint16_t x0, uint16_t y0, uint16_t x1, uint16_t y1)
{
    uint8_t caset[4] = { (uint8_t)(x0 >> 8), (uint8_t)(x0 & 0xFF),
                         (uint8_t)(x1 >> 8), (uint8_t)(x1 & 0xFF) };
    uint8_t raset[4] = { (uint8_t)(y0 >> 8), (uint8_t)(y0 & 0xFF),
                         (uint8_t)(y1 >> 8), (uint8_t)(y1 & 0xFF) };
    ili_cmd(0x2A);  ili_data(caset, 4);   /* CASET */
    ili_cmd(0x2B);  ili_data(raset, 4);   /* RASET */
    ili_cmd(0x2C);                        /* RAMWR */
}

/* Write one physical row of LCD_PHYS_W pixels (already in s_row_buf) */
static void ili_write_row(void)
{
    spi_transaction_t t = {
        .length    = (size_t)LCD_PHYS_W * 2 * 8,
        .tx_buffer = s_row_buf,
        .user      = (void *)1,   /* DC = 1 */
    };
    ESP_ERROR_CHECK(spi_device_polling_transmit(s_spi, &t));
}

/* Write a subsequent row (RAMWRC avoids re-sending the window command) */
static void ili_write_cont_row(void)
{
    /* For standard SPI ILI9342C, just re-assert the data with RAMWRC (0x3C) */
    ili_cmd(0x3C);  /* RAMWRC — memory write continue */
    spi_transaction_t t = {
        .length    = (size_t)LCD_PHYS_W * 2 * 8,
        .tx_buffer = s_row_buf,
        .user      = (void *)1,
    };
    ESP_ERROR_CHECK(spi_device_polling_transmit(s_spi, &t));
}

/* ------------------------------------------------------------------ */
/* Internal fill                                                       */
/* ------------------------------------------------------------------ */

static void screen_fill(uint8_t r, uint8_t g, uint8_t b)
{
    xSemaphoreTake(s_draw_mutex, portMAX_DELAY);

    uint16_t px = ((uint16_t)(r & 0xF8) << 8)
                | ((uint16_t)(g & 0xFC) << 3)
                | (b >> 3);
    uint8_t ph = (uint8_t)(px >> 8);
    uint8_t pl = (uint8_t)(px & 0xFF);

    for (int i = 0; i < LCD_PHYS_W * 2; i += 2) {
        s_row_buf[i]     = ph;
        s_row_buf[i + 1] = pl;
    }

    ili_set_window(0, 0, LCD_PHYS_W - 1, LCD_PHYS_H - 1);
    /* First row already started by RAMWR inside ili_set_window */
    ili_write_row();
    for (int y = 1; y < LCD_PHYS_H; y++) {
        ili_write_cont_row();
    }

    xSemaphoreGive(s_draw_mutex);
}

/* ------------------------------------------------------------------ */
/* Rendering — font + word-wrap (shared algorithm with JC3248W535)    */
/* ------------------------------------------------------------------ */

#define TEXT_COLS_MAX (LCD_MAX_DIM / 8)
#define TEXT_ROWS_MAX (LCD_MAX_DIM / 16)
#define ALL_LINES_MAX 128

/* IBM VGA 8×16 font, ASCII 0x20–0x7E */
static const uint8_t s_font8x16[95][16] = {
    /* 0x20 */ {0x00,0x00,0x00,0x00,0x00,0x00,0x00,0x00,0x00,0x00,0x00,0x00,0x00,0x00,0x00,0x00},
    /* 0x21 */ {0x00,0x00,0x18,0x3c,0x3c,0x3c,0x18,0x18,0x18,0x00,0x18,0x18,0x00,0x00,0x00,0x00},
    /* 0x22 */ {0x00,0x66,0x66,0x66,0x24,0x00,0x00,0x00,0x00,0x00,0x00,0x00,0x00,0x00,0x00,0x00},
    /* 0x23 */ {0x00,0x00,0x00,0x6c,0x6c,0xfe,0x6c,0x6c,0x6c,0xfe,0x6c,0x6c,0x00,0x00,0x00,0x00},
    /* 0x24 */ {0x18,0x18,0x7c,0xc6,0xc2,0xc0,0x7c,0x06,0x06,0x86,0xc6,0x7c,0x18,0x18,0x00,0x00},
    /* 0x25 */ {0x00,0x00,0x00,0x00,0xc2,0xc6,0x0c,0x18,0x30,0x60,0xc6,0x86,0x00,0x00,0x00,0x00},
    /* 0x26 */ {0x00,0x00,0x38,0x6c,0x6c,0x38,0x76,0xdc,0xcc,0xcc,0xcc,0x76,0x00,0x00,0x00,0x00},
    /* 0x27 */ {0x00,0x30,0x30,0x30,0x60,0x00,0x00,0x00,0x00,0x00,0x00,0x00,0x00,0x00,0x00,0x00},
    /* 0x28 */ {0x00,0x00,0x0c,0x18,0x30,0x30,0x30,0x30,0x30,0x30,0x18,0x0c,0x00,0x00,0x00,0x00},
    /* 0x29 */ {0x00,0x00,0x30,0x18,0x0c,0x0c,0x0c,0x0c,0x0c,0x0c,0x18,0x30,0x00,0x00,0x00,0x00},
    /* 0x2a */ {0x00,0x00,0x00,0x00,0x00,0x66,0x3c,0xff,0x3c,0x66,0x00,0x00,0x00,0x00,0x00,0x00},
    /* 0x2b */ {0x00,0x00,0x00,0x00,0x00,0x18,0x18,0x7e,0x18,0x18,0x00,0x00,0x00,0x00,0x00,0x00},
    /* 0x2c */ {0x00,0x00,0x00,0x00,0x00,0x00,0x00,0x00,0x00,0x18,0x18,0x18,0x30,0x00,0x00,0x00},
    /* 0x2d */ {0x00,0x00,0x00,0x00,0x00,0x00,0x00,0xfe,0x00,0x00,0x00,0x00,0x00,0x00,0x00,0x00},
    /* 0x2e */ {0x00,0x00,0x00,0x00,0x00,0x00,0x00,0x00,0x00,0x00,0x18,0x18,0x00,0x00,0x00,0x00},
    /* 0x2f */ {0x00,0x00,0x00,0x00,0x02,0x06,0x0c,0x18,0x30,0x60,0xc0,0x80,0x00,0x00,0x00,0x00},
    /* 0x30 */ {0x00,0x00,0x38,0x6c,0xc6,0xc6,0xd6,0xd6,0xc6,0xc6,0x6c,0x38,0x00,0x00,0x00,0x00},
    /* 0x31 */ {0x00,0x00,0x18,0x38,0x78,0x18,0x18,0x18,0x18,0x18,0x18,0x7e,0x00,0x00,0x00,0x00},
    /* 0x32 */ {0x00,0x00,0x7c,0xc6,0x06,0x0c,0x18,0x30,0x60,0xc0,0xc6,0xfe,0x00,0x00,0x00,0x00},
    /* 0x33 */ {0x00,0x00,0x7c,0xc6,0x06,0x06,0x3c,0x06,0x06,0x06,0xc6,0x7c,0x00,0x00,0x00,0x00},
    /* 0x34 */ {0x00,0x00,0x0c,0x1c,0x3c,0x6c,0xcc,0xfe,0x0c,0x0c,0x0c,0x1e,0x00,0x00,0x00,0x00},
    /* 0x35 */ {0x00,0x00,0xfe,0xc0,0xc0,0xc0,0xfc,0x06,0x06,0x06,0xc6,0x7c,0x00,0x00,0x00,0x00},
    /* 0x36 */ {0x00,0x00,0x38,0x60,0xc0,0xc0,0xfc,0xc6,0xc6,0xc6,0xc6,0x7c,0x00,0x00,0x00,0x00},
    /* 0x37 */ {0x00,0x00,0xfe,0xc6,0x06,0x06,0x0c,0x18,0x30,0x30,0x30,0x30,0x00,0x00,0x00,0x00},
    /* 0x38 */ {0x00,0x00,0x7c,0xc6,0xc6,0xc6,0x7c,0xc6,0xc6,0xc6,0xc6,0x7c,0x00,0x00,0x00,0x00},
    /* 0x39 */ {0x00,0x00,0x7c,0xc6,0xc6,0xc6,0x7e,0x06,0x06,0x06,0x0c,0x78,0x00,0x00,0x00,0x00},
    /* 0x3a */ {0x00,0x00,0x00,0x00,0x18,0x18,0x00,0x00,0x00,0x18,0x18,0x00,0x00,0x00,0x00,0x00},
    /* 0x3b */ {0x00,0x00,0x00,0x00,0x18,0x18,0x00,0x00,0x00,0x18,0x18,0x30,0x00,0x00,0x00,0x00},
    /* 0x3c */ {0x00,0x00,0x00,0x06,0x0c,0x18,0x30,0x60,0x30,0x18,0x0c,0x06,0x00,0x00,0x00,0x00},
    /* 0x3d */ {0x00,0x00,0x00,0x00,0x00,0x7e,0x00,0x00,0x7e,0x00,0x00,0x00,0x00,0x00,0x00,0x00},
    /* 0x3e */ {0x00,0x00,0x00,0x60,0x30,0x18,0x0c,0x06,0x0c,0x18,0x30,0x60,0x00,0x00,0x00,0x00},
    /* 0x3f */ {0x00,0x00,0x7c,0xc6,0xc6,0x0c,0x18,0x18,0x18,0x00,0x18,0x18,0x00,0x00,0x00,0x00},
    /* 0x40 */ {0x00,0x00,0x00,0x7c,0xc6,0xc6,0xde,0xde,0xde,0xdc,0xc0,0x7c,0x00,0x00,0x00,0x00},
    /* 0x41 */ {0x00,0x00,0x10,0x38,0x6c,0xc6,0xc6,0xfe,0xc6,0xc6,0xc6,0xc6,0x00,0x00,0x00,0x00},
    /* 0x42 */ {0x00,0x00,0xfc,0x66,0x66,0x66,0x7c,0x66,0x66,0x66,0x66,0xfc,0x00,0x00,0x00,0x00},
    /* 0x43 */ {0x00,0x00,0x3c,0x66,0xc2,0xc0,0xc0,0xc0,0xc0,0xc2,0x66,0x3c,0x00,0x00,0x00,0x00},
    /* 0x44 */ {0x00,0x00,0xf8,0x6c,0x66,0x66,0x66,0x66,0x66,0x66,0x6c,0xf8,0x00,0x00,0x00,0x00},
    /* 0x45 */ {0x00,0x00,0xfe,0x66,0x62,0x68,0x78,0x68,0x60,0x62,0x66,0xfe,0x00,0x00,0x00,0x00},
    /* 0x46 */ {0x00,0x00,0xfe,0x66,0x62,0x68,0x78,0x68,0x60,0x60,0x60,0xf0,0x00,0x00,0x00,0x00},
    /* 0x47 */ {0x00,0x00,0x3c,0x66,0xc2,0xc0,0xc0,0xde,0xc6,0xc6,0x66,0x3a,0x00,0x00,0x00,0x00},
    /* 0x48 */ {0x00,0x00,0xc6,0xc6,0xc6,0xc6,0xfe,0xc6,0xc6,0xc6,0xc6,0xc6,0x00,0x00,0x00,0x00},
    /* 0x49 */ {0x00,0x00,0x3c,0x18,0x18,0x18,0x18,0x18,0x18,0x18,0x18,0x3c,0x00,0x00,0x00,0x00},
    /* 0x4a */ {0x00,0x00,0x1e,0x0c,0x0c,0x0c,0x0c,0x0c,0xcc,0xcc,0xcc,0x78,0x00,0x00,0x00,0x00},
    /* 0x4b */ {0x00,0x00,0xe6,0x66,0x66,0x6c,0x78,0x78,0x6c,0x66,0x66,0xe6,0x00,0x00,0x00,0x00},
    /* 0x4c */ {0x00,0x00,0xf0,0x60,0x60,0x60,0x60,0x60,0x60,0x62,0x66,0xfe,0x00,0x00,0x00,0x00},
    /* 0x4d */ {0x00,0x00,0xc6,0xee,0xfe,0xfe,0xd6,0xc6,0xc6,0xc6,0xc6,0xc6,0x00,0x00,0x00,0x00},
    /* 0x4e */ {0x00,0x00,0xc6,0xe6,0xf6,0xfe,0xde,0xce,0xc6,0xc6,0xc6,0xc6,0x00,0x00,0x00,0x00},
    /* 0x4f */ {0x00,0x00,0x7c,0xc6,0xc6,0xc6,0xc6,0xc6,0xc6,0xc6,0xc6,0x7c,0x00,0x00,0x00,0x00},
    /* 0x50 */ {0x00,0x00,0xfc,0x66,0x66,0x66,0x7c,0x60,0x60,0x60,0x60,0xf0,0x00,0x00,0x00,0x00},
    /* 0x51 */ {0x00,0x00,0x7c,0xc6,0xc6,0xc6,0xc6,0xc6,0xc6,0xd6,0xde,0x7c,0x0c,0x0e,0x00,0x00},
    /* 0x52 */ {0x00,0x00,0xfc,0x66,0x66,0x66,0x7c,0x6c,0x66,0x66,0x66,0xe6,0x00,0x00,0x00,0x00},
    /* 0x53 */ {0x00,0x00,0x7c,0xc6,0xc6,0x60,0x38,0x0c,0x06,0xc6,0xc6,0x7c,0x00,0x00,0x00,0x00},
    /* 0x54 */ {0x00,0x00,0x7e,0x7e,0x5a,0x18,0x18,0x18,0x18,0x18,0x18,0x3c,0x00,0x00,0x00,0x00},
    /* 0x55 */ {0x00,0x00,0xc6,0xc6,0xc6,0xc6,0xc6,0xc6,0xc6,0xc6,0xc6,0x7c,0x00,0x00,0x00,0x00},
    /* 0x56 */ {0x00,0x00,0xc6,0xc6,0xc6,0xc6,0xc6,0xc6,0xc6,0x6c,0x38,0x10,0x00,0x00,0x00,0x00},
    /* 0x57 */ {0x00,0x00,0xc6,0xc6,0xc6,0xc6,0xd6,0xd6,0xd6,0xfe,0xee,0x6c,0x00,0x00,0x00,0x00},
    /* 0x58 */ {0x00,0x00,0xc6,0xc6,0x6c,0x7c,0x38,0x38,0x7c,0x6c,0xc6,0xc6,0x00,0x00,0x00,0x00},
    /* 0x59 */ {0x00,0x00,0x66,0x66,0x66,0x66,0x3c,0x18,0x18,0x18,0x18,0x3c,0x00,0x00,0x00,0x00},
    /* 0x5a */ {0x00,0x00,0xfe,0xc6,0x86,0x0c,0x18,0x30,0x60,0xc2,0xc6,0xfe,0x00,0x00,0x00,0x00},
    /* 0x5b */ {0x00,0x00,0x3c,0x30,0x30,0x30,0x30,0x30,0x30,0x30,0x30,0x3c,0x00,0x00,0x00,0x00},
    /* 0x5c */ {0x00,0x00,0x00,0x80,0xc0,0xe0,0x70,0x38,0x1c,0x0e,0x06,0x02,0x00,0x00,0x00,0x00},
    /* 0x5d */ {0x00,0x00,0x3c,0x0c,0x0c,0x0c,0x0c,0x0c,0x0c,0x0c,0x0c,0x3c,0x00,0x00,0x00,0x00},
    /* 0x5e */ {0x10,0x38,0x6c,0xc6,0x00,0x00,0x00,0x00,0x00,0x00,0x00,0x00,0x00,0x00,0x00,0x00},
    /* 0x5f */ {0x00,0x00,0x00,0x00,0x00,0x00,0x00,0x00,0x00,0x00,0x00,0x00,0x00,0xff,0x00,0x00},
    /* 0x60 */ {0x00,0x30,0x18,0x0c,0x00,0x00,0x00,0x00,0x00,0x00,0x00,0x00,0x00,0x00,0x00,0x00},
    /* 0x61 */ {0x00,0x00,0x00,0x00,0x00,0x78,0x0c,0x7c,0xcc,0xcc,0xcc,0x76,0x00,0x00,0x00,0x00},
    /* 0x62 */ {0x00,0x00,0xe0,0x60,0x60,0x78,0x6c,0x66,0x66,0x66,0x66,0x7c,0x00,0x00,0x00,0x00},
    /* 0x63 */ {0x00,0x00,0x00,0x00,0x00,0x7c,0xc6,0xc0,0xc0,0xc0,0xc6,0x7c,0x00,0x00,0x00,0x00},
    /* 0x64 */ {0x00,0x00,0x1c,0x0c,0x0c,0x3c,0x6c,0xcc,0xcc,0xcc,0xcc,0x76,0x00,0x00,0x00,0x00},
    /* 0x65 */ {0x00,0x00,0x00,0x00,0x00,0x7c,0xc6,0xfe,0xc0,0xc0,0xc6,0x7c,0x00,0x00,0x00,0x00},
    /* 0x66 */ {0x00,0x00,0x1c,0x36,0x32,0x30,0x78,0x30,0x30,0x30,0x30,0x78,0x00,0x00,0x00,0x00},
    /* 0x67 */ {0x00,0x00,0x00,0x00,0x00,0x76,0xcc,0xcc,0xcc,0xcc,0xcc,0x7c,0x0c,0xcc,0x78,0x00},
    /* 0x68 */ {0x00,0x00,0xe0,0x60,0x60,0x6c,0x76,0x66,0x66,0x66,0x66,0xe6,0x00,0x00,0x00,0x00},
    /* 0x69 */ {0x00,0x00,0x18,0x18,0x00,0x38,0x18,0x18,0x18,0x18,0x18,0x3c,0x00,0x00,0x00,0x00},
    /* 0x6a */ {0x00,0x00,0x06,0x06,0x00,0x0e,0x06,0x06,0x06,0x06,0x06,0x06,0x66,0x66,0x3c,0x00},
    /* 0x6b */ {0x00,0x00,0xe0,0x60,0x60,0x66,0x6c,0x78,0x78,0x6c,0x66,0xe6,0x00,0x00,0x00,0x00},
    /* 0x6c */ {0x00,0x00,0x38,0x18,0x18,0x18,0x18,0x18,0x18,0x18,0x18,0x3c,0x00,0x00,0x00,0x00},
    /* 0x6d */ {0x00,0x00,0x00,0x00,0x00,0xec,0xfe,0xd6,0xd6,0xd6,0xd6,0xc6,0x00,0x00,0x00,0x00},
    /* 0x6e */ {0x00,0x00,0x00,0x00,0x00,0xdc,0x66,0x66,0x66,0x66,0x66,0x66,0x00,0x00,0x00,0x00},
    /* 0x6f */ {0x00,0x00,0x00,0x00,0x00,0x7c,0xc6,0xc6,0xc6,0xc6,0xc6,0x7c,0x00,0x00,0x00,0x00},
    /* 0x70 */ {0x00,0x00,0x00,0x00,0x00,0xdc,0x66,0x66,0x66,0x66,0x66,0x7c,0x60,0x60,0xf0,0x00},
    /* 0x71 */ {0x00,0x00,0x00,0x00,0x00,0x76,0xcc,0xcc,0xcc,0xcc,0xcc,0x7c,0x0c,0x0c,0x1e,0x00},
    /* 0x72 */ {0x00,0x00,0x00,0x00,0x00,0xdc,0x76,0x66,0x60,0x60,0x60,0xf0,0x00,0x00,0x00,0x00},
    /* 0x73 */ {0x00,0x00,0x00,0x00,0x00,0x7c,0xc6,0x60,0x38,0x0c,0xc6,0x7c,0x00,0x00,0x00,0x00},
    /* 0x74 */ {0x00,0x00,0x10,0x30,0x30,0xfc,0x30,0x30,0x30,0x30,0x36,0x1c,0x00,0x00,0x00,0x00},
    /* 0x75 */ {0x00,0x00,0x00,0x00,0x00,0xcc,0xcc,0xcc,0xcc,0xcc,0xcc,0x76,0x00,0x00,0x00,0x00},
    /* 0x76 */ {0x00,0x00,0x00,0x00,0x00,0xc6,0xc6,0xc6,0xc6,0xc6,0x6c,0x38,0x00,0x00,0x00,0x00},
    /* 0x77 */ {0x00,0x00,0x00,0x00,0x00,0xc6,0xc6,0xd6,0xd6,0xd6,0xfe,0x6c,0x00,0x00,0x00,0x00},
    /* 0x78 */ {0x00,0x00,0x00,0x00,0x00,0xc6,0x6c,0x38,0x38,0x38,0x6c,0xc6,0x00,0x00,0x00,0x00},
    /* 0x79 */ {0x00,0x00,0x00,0x00,0x00,0xc6,0xc6,0xc6,0xc6,0xc6,0xc6,0x7e,0x06,0x0c,0xf8,0x00},
    /* 0x7a */ {0x00,0x00,0x00,0x00,0x00,0xfe,0xcc,0x18,0x30,0x60,0xc6,0xfe,0x00,0x00,0x00,0x00},
    /* 0x7b */ {0x00,0x00,0x0e,0x18,0x18,0x18,0x70,0x18,0x18,0x18,0x18,0x0e,0x00,0x00,0x00,0x00},
    /* 0x7c */ {0x00,0x00,0x18,0x18,0x18,0x18,0x18,0x18,0x18,0x18,0x18,0x18,0x00,0x00,0x00,0x00},
    /* 0x7d */ {0x00,0x00,0x70,0x18,0x18,0x18,0x0e,0x18,0x18,0x18,0x18,0x70,0x00,0x00,0x00,0x00},
    /* 0x7e */ {0x00,0x76,0xdc,0x00,0x00,0x00,0x00,0x00,0x00,0x00,0x00,0x00,0x00,0x00,0x00,0x00},
};

static bool text_pixel_is_fg(int logical_x, int logical_y,
                              const char (*lines)[TEXT_COLS_MAX + 1],
                              const int *line_len, int num_lines,
                              int logical_w, int start_y)
{
    int scale = s_font_scale;
    int cw    = 8  * scale;
    int ch    = 16 * scale;

    int rel_y = logical_y - start_y;
    if (rel_y < 0 || rel_y >= num_lines * ch) return false;

    int trow     = rel_y / ch;
    int ci_count = line_len[trow];
    int start_x  = (logical_w - ci_count * cw) / 2;
    int rel_x    = logical_x - start_x;
    if (rel_x < 0 || rel_x >= ci_count * cw) return false;

    int char_index = rel_x / cw;
    unsigned char glyph = (unsigned char)lines[trow][char_index];
    if (glyph < 0x20 || glyph > 0x7E) glyph = '?';
    int gi = glyph - 0x20;

    int font_col = (rel_x % cw) / scale;
    int font_row = (rel_y % ch) / scale;
    return (s_font8x16[gi][font_row] & (0x80u >> font_col)) != 0;
}

static void apply_scroll_abs(int target)
{
    if (s_scroll_total == 0) return;
    int max_rows  = lcd_h() / (16 * s_font_scale);
    int max_scroll = s_scroll_total - max_rows;
    if (max_scroll <= 0) return;
    if (target < 0)          target = 0;
    if (target > max_scroll) target = max_scroll;
    if (target == s_scroll_line) return;
    s_scroll_line = target;
    screen_draw_text(s_text);
}

/* ------------------------------------------------------------------ */
/* Touch (FT6336U)                                                     */
/* ------------------------------------------------------------------ */

static bool touch_read_point(uint16_t *tx, uint16_t *ty)
{
    uint8_t reg  = 0x02;
    uint8_t npts = 0;
    if (i2c_master_write_read_device(AXP_I2C_NUM, TOUCH_I2C_ADDR,
                                     &reg, 1, &npts, 1,
                                     pdMS_TO_TICKS(10)) != ESP_OK) {
        return false;
    }
    if (npts == 0 || npts > 5) return false;

    uint8_t data[4];
    uint8_t data_reg = 0x03;
    if (i2c_master_write_read_device(AXP_I2C_NUM, TOUCH_I2C_ADDR,
                                     &data_reg, 1, data, 4,
                                     pdMS_TO_TICKS(10)) != ESP_OK) {
        return false;
    }
    *tx = (uint16_t)(((data[0] & 0x0F) << 8) | data[1]);
    *ty = (uint16_t)(((data[2] & 0x0F) << 8) | data[3]);
    return true;
}

static void touch_poll_task(void *arg)
{
    (void)arg;
    bool    touching     = false;
    int     start_scroll = 0;
    int16_t start_v      = 0;

    for (;;) {
        vTaskDelay(pdMS_TO_TICKS(20));

        uint16_t tx, ty;
        bool have = touch_read_point(&tx, &ty);

        /*
         * For Core2 (320×240 landscape native), the FT6336U reports:
         *   raw X (0..319) = horizontal axis of the physical panel
         *   raw Y (0..239) = vertical axis of the physical panel
         *
         * In landscape mode (320×240): vertical scroll axis = raw Y
         * In portrait mode (software-rotated 240×320): vertical scroll
         *   axis in logical space maps to raw X in physical space.
         */
        int16_t raw_v = s_landscape ? (int16_t)ty : (int16_t)tx;
        int     sign  = 1;   /* increasing raw_v = scrolling down */

        if (have && !touching) {
            touching     = true;
            start_scroll = s_scroll_line;
            start_v      = raw_v;
        } else if (have) {
            int row_h = 16 * s_font_scale;
            if (row_h == 0) continue;
            int delta_lines = sign * ((int)raw_v - (int)start_v) / row_h;
            apply_scroll_abs(start_scroll + delta_lines);
        } else if (touching) {
            touching = false;
        }
    }
}

/* ------------------------------------------------------------------ */
/* Public API                                                          */
/* ------------------------------------------------------------------ */

esp_err_t screen_init(void)
{
    s_draw_mutex = xSemaphoreCreateMutex();

    /* ── I2C (AXP192 + FT6336U) ─────────────────────────────────────── */
    i2c_config_t i2c_cfg = {
        .mode             = I2C_MODE_MASTER,
        .sda_io_num       = I2C_SDA_GPIO,
        .scl_io_num       = I2C_SCL_GPIO,
        .sda_pullup_en    = GPIO_PULLUP_ENABLE,
        .scl_pullup_en    = GPIO_PULLUP_ENABLE,
        .master.clk_speed = 400000,
    };
    esp_err_t i2c_err = i2c_param_config(AXP_I2C_NUM, &i2c_cfg);
    if (i2c_err == ESP_OK) {
        i2c_err = i2c_driver_install(AXP_I2C_NUM, I2C_MODE_MASTER, 0, 0, 0);
    }
    if (i2c_err != ESP_OK) {
        ESP_LOGE(TAG, "I2C init failed: %s", esp_err_to_name(i2c_err));
        return i2c_err;
    }
    ESP_LOGI(TAG, "I2C ready (SDA=%d SCL=%d)", I2C_SDA_GPIO, I2C_SCL_GPIO);

    /* ── AXP192 PMU — power LCD via DCDC3 + LDO2, keep vibration off ─── */
    /*
    * Core2 reference rail mapping (AXP192):
    *   - DCDC3 (reg 0x27) -> LCD/backlight rail (set to 2.8V)
    *   - LDO2  (reg 0x28 hi nibble) -> LCD logic rail (3.3V)
    *   - LDO3  (reg 0x28 lo nibble) -> vibration motor preset (2.0V), keep disabled
    *   - Enable bits in reg 0x12: DCDC3 bit1 + LDO2 bit2 ON, LDO3 bit3 OFF
    *   - Toggle LCD reset via reg 0x96 bit1 (SetLCDRSet equivalent)
     */
    uint8_t reg30 = 0;
    if (axp_read(0x30, &reg30) == ESP_OK) {
        axp_write(0x30, (reg30 & 0x04) | 0x02); /* disable VBUS current limit */
    }
    axp_write(0x82, 0xFF);              /* enable all ADC channels              */
    axp_write(0x27, 0x54);              /* DCDC3 = 2.8V                         */
    axp_write(0x28, 0xF2);              /* LDO2 = 3.3V, LDO3 preset = 2.0V      */
    axp_read_modify_write(0x12, 0x0E, 0x06); /* ON: DCDC3+LDO2, OFF: LDO3          */
    axp_read_modify_write(0x96, 0x02, 0x00); /* LCD reset low                        */
    vTaskDelay(pdMS_TO_TICKS(20));
    axp_read_modify_write(0x96, 0x02, 0x02); /* LCD reset high                       */
    vTaskDelay(pdMS_TO_TICKS(50));
    ESP_LOGI(TAG, "AXP192 LCD rails on (DCDC3/LDO2), vibration rail off");

    /* ── DC pin (GPIO output) ────────────────────────────────────────── */
    gpio_config_t dc_cfg = {
        .pin_bit_mask = BIT64(LCD_DC),
        .mode         = GPIO_MODE_OUTPUT,
    };
    gpio_config(&dc_cfg);
    gpio_set_level(LCD_DC, 1);

    /* ── SPI bus ─────────────────────────────────────────────────────── */
    spi_bus_config_t bus = {
        .mosi_io_num   = LCD_MOSI,
        .miso_io_num   = LCD_MISO,
        .sclk_io_num   = LCD_CLK,
        .quadwp_io_num = -1,
        .quadhd_io_num = -1,
        .max_transfer_sz = (LCD_PHYS_W * 2) + 4,
    };
    ESP_ERROR_CHECK(spi_bus_initialize(LCD_HOST, &bus, SPI_DMA_CH_AUTO));

    spi_device_interface_config_t dev = {
        .clock_speed_hz = LCD_CLK_HZ,
        .mode           = 0,
        .spics_io_num   = LCD_CS,
        .queue_size     = 1,
        .pre_cb         = ili_pre_cb,
    };
    ESP_ERROR_CHECK(spi_bus_add_device(LCD_HOST, &dev, &s_spi));

    /* ── ILI9342C initialisation ─────────────────────────────────────── */
    vTaskDelay(pdMS_TO_TICKS(20));

    ili_cmd(0x01);                              /* SW_RESET          */
    vTaskDelay(pdMS_TO_TICKS(150));

    ili_cmd(0x11);                              /* SLEEP_OUT         */
    vTaskDelay(pdMS_TO_TICKS(120));

    /* ILI9342C extended init sequence (matches known-good Core2 panel bring-up). */
    { uint8_t d[] = {0xFF, 0x93, 0x42}; ili_cmd(0xC8); ili_data(d, sizeof(d)); } /* SETEXTC */
    { uint8_t d[] = {0x12, 0x12};       ili_cmd(0xC0); ili_data(d, sizeof(d)); } /* PWCTR1  */
    { uint8_t d[] = {0x03};             ili_cmd(0xC1); ili_data(d, sizeof(d)); } /* PWCTR2  */
    { uint8_t d[] = {0xF2};             ili_cmd(0xC5); ili_data(d, sizeof(d)); } /* VMCTR1  */
    { uint8_t d[] = {0xE0};             ili_cmd(0xB0); ili_data(d, sizeof(d)); }
    { uint8_t d[] = {0x01, 0x00, 0x00}; ili_cmd(0xF6); ili_data(d, sizeof(d)); }
    {
        uint8_t d[] = {
            0x00, 0x0C, 0x11, 0x04, 0x11,
            0x08, 0x37, 0x89, 0x4C, 0x06,
            0x0C, 0x0A, 0x2E, 0x34, 0x0F
        };
        ili_cmd(0xE0); ili_data(d, sizeof(d)); /* GMCTRP1 */
    }
    {
        uint8_t d[] = {
            0x00, 0x0B, 0x11, 0x05, 0x13,
            0x09, 0x33, 0x67, 0x48, 0x07,
            0x0E, 0x0B, 0x2E, 0x33, 0x0F
        };
        ili_cmd(0xE1); ili_data(d, sizeof(d)); /* GMCTRN1 */
    }
    { uint8_t d[] = {0x08, 0x82, 0x1D, 0x04}; ili_cmd(0xB6); ili_data(d, sizeof(d)); } /* DFUNCTR */
    ili_cmd(0x38);                              /* IDMOFF (idle off) */

    ili_cmd(0x3A); ili_data_byte(0x55);         /* COLMOD: RGB565    */
    ili_cmd(0x36); ili_data_byte(MADCTL_LANDSCAPE); /* MADCTL        */
    ili_cmd(0x21);                              /* INVERT_ON         */

    ili_cmd(0x29);                              /* DISPLAY_ON        */
    vTaskDelay(pdMS_TO_TICKS(20));

    /* Quick power-on diagnostic: proves whether GRAM writes are reaching LCD. */
    ESP_LOGI(TAG, "Core2 LCD RGB self-test (red/green/blue)");
    screen_fill(0xFF, 0x00, 0x00);
    vTaskDelay(pdMS_TO_TICKS(450));
    screen_fill(0x00, 0xFF, 0x00);
    vTaskDelay(pdMS_TO_TICKS(450));
    screen_fill(0x00, 0x00, 0xFF);
    vTaskDelay(pdMS_TO_TICKS(450));

    /* Blackout after test so first app frame is deterministic. */
    screen_off();

    ESP_LOGI(TAG, "ILI9342C ready (%d x %d @ %d MHz SPI)",
             lcd_w(), lcd_h(), LCD_CLK_HZ / 1000000);

    /* ── Touch (FT6336U) ─────────────────────────────────────────────── */
    /* I2C already init'd above; just verify the device is responsive */
    uint8_t reg_00 = 0x00, dev_mode = 0;
    esp_err_t t_err = i2c_master_write_read_device(AXP_I2C_NUM, TOUCH_I2C_ADDR,
                                                    &reg_00, 1, &dev_mode, 1,
                                                    pdMS_TO_TICKS(20));
    if (t_err == ESP_OK) {
        ESP_LOGI(TAG, "FT6336U touch ready (I2C addr=0x%02X)", TOUCH_I2C_ADDR);
        xTaskCreate(touch_poll_task, "touch_poll", 2048, NULL, 5, NULL);
    } else {
        ESP_LOGW(TAG, "FT6336U not found (err=%d) — scroll by touch unavailable", t_err);
    }

    return ESP_OK;
}

void screen_set_color(uint8_t r, uint8_t g, uint8_t b)
{
    s_r = r;  s_g = g;  s_b = b;
    if (s_text[0]) screen_draw_text(s_text);
    else           screen_fill(r, g, b);
}

void screen_off(void)
{
    s_r = s_g = s_b = 0;
    s_text[0] = '\0';
    screen_fill(0, 0, 0);
}

void screen_get_color(uint8_t *r, uint8_t *g, uint8_t *b)
{
    *r = s_r;  *g = s_g;  *b = s_b;
}

void screen_set_landscape(bool landscape)
{
    s_landscape = landscape;
    if (s_text[0]) screen_draw_text(s_text);
    else           screen_fill(s_r, s_g, s_b);
}

void screen_get_landscape(bool *landscape)
{
    *landscape = s_landscape;
}

void screen_set_font_scale(int scale)
{
    if (scale < 1) scale = 1;
    if (scale > 8) scale = 8;
    s_font_scale = scale;
    if (s_text[0]) screen_draw_text(s_text);
}

void screen_get_font_scale(int *scale) { *scale = s_font_scale; }

void screen_set_text_color(uint8_t r, uint8_t g, uint8_t b)
{
    s_fr = r;  s_fg = g;  s_fb = b;
    if (s_text[0]) screen_draw_text(s_text);
}

void screen_get_text_color(uint8_t *r, uint8_t *g, uint8_t *b)
{
    *r = s_fr;  *g = s_fg;  *b = s_fb;
}

void screen_draw_text(const char *text)
{
    xSemaphoreTake(s_draw_mutex, portMAX_DELAY);

    if (text != s_text) {
        strncpy(s_text, text, sizeof(s_text) - 1);
        s_text[sizeof(s_text) - 1] = '\0';
        s_scroll_line = 0;
    }

    static char all_lines[ALL_LINES_MAX][TEXT_COLS_MAX + 1];
    static int  all_len[ALL_LINES_MAX];
    int total_lines = 0;

    int max_cols = lcd_w()  / (8  * s_font_scale);
    int max_rows = lcd_h()  / (16 * s_font_scale);

    const char *src = s_text;
    while (*src && total_lines < ALL_LINES_MAX) {
        while (*src == ' ') src++;
        if (*src == '\0') break;
        if (*src == '\n') {
            all_lines[total_lines][0] = '\0';
            all_len[total_lines] = 0;
            total_lines++;
            src++;
            continue;
        }
        const char *nl = strchr(src, '\n');
        int line_len = nl ? (int)(nl - src) : (int)strlen(src);
        int avail    = max_cols;
        int take;
        if (line_len <= avail) {
            take = line_len;
        } else {
            take = avail;
            while (take > 0 && src[take] != ' ') take--;
            if (take == 0) take = avail;
        }
        memcpy(all_lines[total_lines], src, (size_t)take);
        all_lines[total_lines][take] = '\0';
        all_len[total_lines] = take;
        total_lines++;
        src += take;
        if (take == line_len && nl != NULL) src++;
    }

    if (total_lines == 0) {
        xSemaphoreGive(s_draw_mutex);
        return;
    }

    s_scroll_total = total_lines;

    int start_y;
    int first, num_visible;
    int ch = 16 * s_font_scale;

    if (total_lines <= max_rows) {
        s_scroll_line = 0;
        first       = 0;
        num_visible = total_lines;
        start_y     = (lcd_h() - total_lines * ch) / 2;
    } else {
        int max_scroll = total_lines - max_rows;
        if (s_scroll_line < 0)          s_scroll_line = 0;
        if (s_scroll_line > max_scroll) s_scroll_line = max_scroll;
        first       = s_scroll_line;
        num_visible = max_rows;
        start_y     = 0;
    }

    uint16_t bg = ((uint16_t)(s_r & 0xF8) << 8)
                | ((uint16_t)(s_g & 0xFC) << 3)
                | (s_b >> 3);
    uint8_t bg_h = (uint8_t)(bg >> 8);
    uint8_t bg_l = (uint8_t)(bg & 0xFF);
    uint16_t fg  = ((uint16_t)(s_fr & 0xF8) << 8)
                 | ((uint16_t)(s_fg & 0xFC) << 3)
                 | (s_fb >> 3);
    uint8_t fg_h = (uint8_t)(fg >> 8);
    uint8_t fg_l = (uint8_t)(fg & 0xFF);

    int logical_w = lcd_w();

    ili_set_window(0, 0, LCD_PHYS_W - 1, LCD_PHYS_H - 1);

    for (int y = 0; y < LCD_PHYS_H; y++) {
        for (int i = 0; i < LCD_PHYS_W * 2; i += 2) {
            s_row_buf[i]     = bg_h;
            s_row_buf[i + 1] = bg_l;
        }

        for (int x = 0; x < LCD_PHYS_W; x++) {
            int lx, ly;
            if (s_landscape) {
                /* Native orientation: logical = physical */
                lx = x;
                ly = y;
            } else {
                /* Portrait (software CCW-rotate): logical 240×320 */
                lx = (LCD_PHYS_H - 1) - y;
                ly = x;
            }

            if (text_pixel_is_fg(lx, ly,
                    (const char (*)[TEXT_COLS_MAX + 1])&all_lines[first],
                    &all_len[first], num_visible, logical_w, start_y)) {
                s_row_buf[x * 2]     = fg_h;
                s_row_buf[x * 2 + 1] = fg_l;
            }
        }

        if (y == 0) ili_write_row();
        else        ili_write_cont_row();
    }

    xSemaphoreGive(s_draw_mutex);
}

void screen_draw_rgb565(const uint8_t *rgb565, int src_w, int src_h)
{
    xSemaphoreTake(s_draw_mutex, portMAX_DELAY);

    s_text[0] = '\0';

    int dst_w = lcd_w();
    int dst_h = lcd_h();

    int img_w, img_h, img_x0, img_y0;
    if (src_w * dst_h > src_h * dst_w) {
        img_w = dst_w;
        img_h = (src_h * dst_w) / src_w;
    } else {
        img_h = dst_h;
        img_w = (src_w * dst_h) / src_h;
    }
    img_x0 = (dst_w - img_w) / 2;
    img_y0 = (dst_h - img_h) / 2;

    uint16_t bg_px = ((uint16_t)(s_r & 0xF8) << 8)
                   | ((uint16_t)(s_g & 0xFC) << 3)
                   | (s_b >> 3);
    uint8_t bg_h = (uint8_t)(bg_px >> 8);
    uint8_t bg_l = (uint8_t)(bg_px & 0xFF);

    const uint16_t *src = (const uint16_t *)rgb565;

    ili_set_window(0, 0, LCD_PHYS_W - 1, LCD_PHYS_H - 1);

    for (int y = 0; y < LCD_PHYS_H; y++) {
        for (int i = 0; i < LCD_PHYS_W * 2; i += 2) {
            s_row_buf[i]     = bg_h;
            s_row_buf[i + 1] = bg_l;
        }

        for (int x = 0; x < LCD_PHYS_W; x++) {
            int lx, ly;
            if (s_landscape) {
                lx = x;
                ly = y;
            } else {
                lx = (LCD_PHYS_H - 1) - y;
                ly = x;
            }

            if (lx < img_x0 || lx >= img_x0 + img_w ||
                ly < img_y0 || ly >= img_y0 + img_h) {
                continue;
            }

            int src_col = ((lx - img_x0) * src_w) / img_w;
            int src_row = ((ly - img_y0) * src_h) / img_h;
            uint16_t pixel = src[src_row * src_w + src_col];
            s_row_buf[x * 2]     = (uint8_t)(pixel >> 8);
            s_row_buf[x * 2 + 1] = (uint8_t)(pixel & 0xFF);
        }

        if (y == 0) ili_write_row();
        else        ili_write_cont_row();
    }

    xSemaphoreGive(s_draw_mutex);
}
