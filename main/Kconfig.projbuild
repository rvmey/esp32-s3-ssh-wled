## main/Kconfig.projbuild
```kconfig
menu "ESP32 SSH LED Configuration"

    choice HARDWARE_VARIANT
        prompt "Hardware variant"
        default HARDWARE_DEVKITC
        help
            Select the target board. This controls which output device
            (onboard LED or QSPI display) responds to SSH color commands.

        config HARDWARE_DEVKITC
            bool "ESP32-S3-DevKitC-1 (onboard WS2812 RGB LED on GPIO 48)"

        config HARDWARE_JC3248W535
            bool "Guition JC3248W535 (320x480 AXS15231 QSPI display)"

        config HARDWARE_BIKE_TRACKER
            bool "ESP32-S3 Bike Tracker (MPU6050 + u-blox GPS)"

        config HARDWARE_PICTURE_FRAME
            bool "TriggerCMD Picture Frame (JC3248W535 + Socket.IO commands)"

        config HARDWARE_TCMD_ATOM_ECHO
            bool "TRIGGERcmd ATOM Echo (M5Stack ATOM Echo, ESP32-PICO-D4)"

        config HARDWARE_ATOMS3_LITE
            bool "TRIGGERcmd AtomS3 Lite (M5Stack AtomS3 Lite, ESP32-S3, RGB LED + button)"

        config HARDWARE_CORE2
            bool "TRIGGERcmd Core2 Display (M5Stack Core2 for AWS, ILI9342C 320x240 SPI)"

        config HARDWARE_CYD
            bool "TRIGGERcmd CYD Display (ESP32-2432S028R, Core2-compatible profile)"

        config HARDWARE_ESP32S3_CAM
            bool "ESP32-S3 Camera (Seeed XIAO ESP32-S3 Sense, OV2640) — HTTP JPEG server"
    endchoice


    menu "Bike Tracker Settings"
        depends on HARDWARE_BIKE_TRACKER

        config MPU6050_I2C_PORT
            int "MPU6050 I2C port number"
            default 0
            range 0 1
            help
                I2C peripheral (0 or 1) the MPU6050 is wired to.

        config MPU6050_SDA_GPIO
            int "MPU6050 SDA GPIO"
            default 8
            range 0 48

        config MPU6050_SCL_GPIO
            int "MPU6050 SCL GPIO"
            default 9
            range 0 48

        config MPU6050_INT_GPIO
            int "MPU6050 INT GPIO (must be RTC-capable, 0-21)"
            default 4
            range 0 21
            help
                GPIO connected to the MPU6050 INT pin. Must be an RTC-capable
                GPIO (0-21 on ESP32-S3) for use as an EXT0 deep-sleep wakeup
                source.

        config MPU6050_AD0_HIGH
            bool "MPU6050 AD0 pin is HIGH (I2C address 0x69)"
            default n
            help
                Clear (default) = address 0x68 (AD0 low).
                Set = address 0x69 (AD0 high).

        config GPS_UART_NUM
            int "GPS UART number"
            default 1
            range 0 2

        config GPS_UART_RX_GPIO
            int "GPS UART RX GPIO"
            default 18
            range 0 48

        config GPS_UART_TX_GPIO
            int "GPS UART TX GPIO"
            default 17
            range 0 48

        config GPS_POWER_GPIO
            int "GPS power-enable GPIO (-1 = not used)"
            default -1
            range -1 48
            help
                Optional GPIO that enables power to the GPS module.
                Set to -1 if no power control pin is wired.

        config GPS_FIX_TIMEOUT_S
            int "GPS fix timeout (seconds)"
            default 60
            range 10 300
            help
                Seconds to wait for a 3D GPS fix before giving up and
                going back to deep sleep without logging a ride.

        config TRACKER_LOG_INTERVAL_S
            int "Track-point log interval (seconds)"
            default 5
            range 1 60
            help
                One GPS track-point is recorded every this many seconds.

        config TRACKER_INACTIVITY_TIMEOUT_S
            int "Inactivity timeout before sleep (seconds)"
            default 30
            range 5 300
            help
                If no motion is detected for this many seconds, the current
                ride is finished and the device returns to deep sleep.

        config TRACKER_HALL_ENABLE
            bool "Enable KY-003 hall speed sensor"
            default y
            help
                Enable digital pulse capture from a KY-003 hall sensor.

        config TRACKER_HALL_GPIO
            int "KY-003 hall sensor GPIO (must be RTC-capable, 0-21)"
            default 5
            range 0 21
            depends on TRACKER_HALL_ENABLE
            help
                GPIO connected to the KY-003 digital output. Must be an
                RTC-capable GPIO to support deep-sleep wakeup via EXT1.

        config TRACKER_HALL_ACTIVE_HIGH
            bool "KY-003 active level is HIGH"
            default n
            depends on TRACKER_HALL_ENABLE
            help
                Set if your module drives HIGH when magnet is detected.
                Leave disabled if magnet detection pulls the output LOW.

        config TRACKER_WHEEL_CIRCUM_MM
            int "Wheel circumference (mm)"
            default 2105
            range 500 4000
            depends on TRACKER_HALL_ENABLE
            help
                Circumference used to convert hall pulses into wheel speed.

        config TRACKER_HALL_PULSES_PER_REV
            int "Hall pulses per wheel revolution"
            default 1
            range 1 16
            depends on TRACKER_HALL_ENABLE
            help
                Number of KY-003 pulses generated for one wheel revolution.

        config TRACKER_UPLOAD_URL
            string "Ride upload URL (empty = disable upload)"
            default ""
            help
                HTTP endpoint that receives ride data as a JSON POST.
                Leave empty to store rides locally without uploading.
    endmenu

    menu "Core2 Settings"
        depends on HARDWARE_CORE2 || HARDWARE_CYD

        config CORE2_SLEEP_TIMEOUT_S
            int "Deep-sleep idle timeout (seconds; 0 = disabled)"
            default 600
            range 0 7200
            help
                Seconds of inactivity (no touch, no TRIGGERcmd command) before
                the device enters deep sleep.  On Core2, touching the screen
                (FT6336U INT on GPIO 39) wakes the device.  On CYD, touch-wake
                uses CONFIG_CYD_XPT2046_IRQ_GPIO above.  Set to 0 to disable
                auto-sleep.
    endmenu

    menu "CYD Settings"
        depends on HARDWARE_CYD

        choice CYD_TOUCH_CONTROLLER
            prompt "Touch controller"
            default CYD_TOUCH_NONE

            config CYD_TOUCH_NONE
                bool "None"

            config CYD_TOUCH_XPT2046
                bool "XPT2046 (SPI resistive)"

            config CYD_TOUCH_CST816
                bool "CST816 (I2C capacitive)"
        endchoice

        config CYD_LCD_MOSI_GPIO
            int "LCD MOSI GPIO"
            default 13
            range -1 48

        config CYD_LCD_MISO_GPIO
            int "LCD MISO GPIO (-1 if unused)"
            default -1
            range -1 48

        config CYD_LCD_SCLK_GPIO
            int "LCD SCLK GPIO"
            default 14
            range -1 48

        config CYD_LCD_CS_GPIO
            int "LCD CS GPIO"
            default 15
            range -1 48

        config CYD_LCD_DC_GPIO
            int "LCD DC GPIO"
            default 2
            range -1 48

        config CYD_LCD_RST_GPIO
            int "LCD reset GPIO (-1 = no dedicated reset pin)"
            default -1
            range -1 48

        config CYD_BACKLIGHT_GPIO
            int "Backlight GPIO (-1 = unmanaged)"
            default 21
            range -1 48

        config CYD_BACKLIGHT_ACTIVE_HIGH
            bool "Backlight active HIGH"
            default y

        config CYD_TOUCH_POLL_MS
            int "Touch poll interval (ms)"
            default 20
            range 5 100

        config CYD_TOUCH_TAP_THRESHOLD
            int "Tap threshold (pixels)"
            default 12
            range 2 60

        config CYD_XPT2046_CS_GPIO
            int "XPT2046 CS GPIO"
            default 33
            range -1 48
            depends on CYD_TOUCH_XPT2046

        config CYD_XPT2046_MOSI_GPIO
            int "XPT2046 MOSI (T_DIN) GPIO"
            default 32
            range -1 48
            depends on CYD_TOUCH_XPT2046
            help
                The XPT2046 on common ESP32-2432S028R boards is wired to its
                own SPI pins, separate from both the LCD bus (MOSI=13/
                SCLK=14/CS=15) and the onboard SD card bus (MOSI=23/MISO=19/
                SCLK=18/CS=5). Since the ESP32 only has two general-purpose
                SPI hosts (HSPI/VSPI) and both are already used by the LCD
                and SD card, touch is read via bit-banged (software) SPI on
                these GPIOs instead of a third hardware SPI host.

        config CYD_XPT2046_MISO_GPIO
            int "XPT2046 MISO (T_DO) GPIO"
            default 39
            range -1 48
            depends on CYD_TOUCH_XPT2046

        config CYD_XPT2046_SCLK_GPIO
            int "XPT2046 SCLK (T_CLK) GPIO"
            default 25
            range -1 48
            depends on CYD_TOUCH_XPT2046

        config CYD_XPT2046_IRQ_GPIO
            int "XPT2046 T_IRQ GPIO (-1 = none)"
            default 36
            range -1 48
            depends on CYD_TOUCH_XPT2046
            help
                XPT2046 touch-interrupt line, used to wake the device from
                deep sleep on touch (see "sleep" command and the idle-sleep
                timeout below). Goes low while the screen is touched. 36 is
                the common wiring for ESP32-2432S028R boards, but CYD
                board-to-board wiring varies -- set to -1 if T_IRQ is not
                connected, which disables touch-wake (deep sleep then lasts
                until reset/power-cycle).

        config CYD_XPT2046_X_MIN
            int "XPT2046 raw X min"
            default 200
            range 0 4095
            depends on CYD_TOUCH_XPT2046

        config CYD_XPT2046_X_MAX
            int "XPT2046 raw X max"
            default 3900
            range 0 4095
            depends on CYD_TOUCH_XPT2046

        config CYD_XPT2046_Y_MIN
            int "XPT2046 raw Y min"
            default 200
            range 0 4095
            depends on CYD_TOUCH_XPT2046

        config CYD_XPT2046_Y_MAX
            int "XPT2046 raw Y max"
            default 3900
            range 0 4095
            depends on CYD_TOUCH_XPT2046

        config CYD_XPT2046_SWAP_XY
            bool "XPT2046 swap X and Y"
            default y
            depends on CYD_TOUCH_XPT2046

        config CYD_XPT2046_INVERT_X
            bool "XPT2046 invert X"
            default n
            depends on CYD_TOUCH_XPT2046

        config CYD_XPT2046_INVERT_Y
            bool "XPT2046 invert Y"
            default n
            depends on CYD_TOUCH_XPT2046

        config CYD_CST816_I2C_SDA_GPIO
            int "CST816 SDA GPIO"
            default 32
            range -1 48
            depends on CYD_TOUCH_CST816

        config CYD_CST816_I2C_SCL_GPIO
            int "CST816 SCL GPIO"
            default 33
            range -1 48
            depends on CYD_TOUCH_CST816

        config CYD_CST816_I2C_ADDR
            hex "CST816 I2C address"
            default 0x15
            depends on CYD_TOUCH_CST816
    endmenu

    config WIFI_SSID
        string "WiFi SSID"
        default "MyWifi"
        help
            SSID of the Wi-Fi network to connect to.

    config WIFI_PASSWORD
        string "WiFi Password"
        default ""
        help
            Password for the Wi-Fi network.

    config SSH_PORT
        int "SSH Server Port"
        default 22
        range 1 65535
        help
            TCP port on which the SSH server listens.

    config SSH_USERNAME
        string "SSH Username"
        default "admin"
        help
            Username accepted by the SSH server.

    config SSH_PASSWORD
        string "SSH Password"
        default "esp32led"
        help
            Password accepted by the SSH server.

endmenu
```

## sdkconfig.defaults
```kconfig
# Increase main stack size for wolfSSH (must be >= 10500 for wolfSSL RSA)
CONFIG_ESP_MAIN_TASK_STACK_SIZE=12288
CONFIG_ESP_WOLFSSL_NO_STACK_SIZE_BUILD_WARNING=y
CONFIG_ESP_ENABLE_WOLFSSH=y

# WiFi
CONFIG_ESP_WIFI_STATIC_RX_BUFFER_NUM=4
CONFIG_ESP_WIFI_DYNAMIC_RX_BUFFER_NUM=8
CONFIG_ESP32S3_DEFAULT_CPU_FREQ_240=y

# Networking
CONFIG_LWIP_MAX_SOCKETS=8
CONFIG_LWIP_SO_RCVBUF=y

# NVS partition for storing SSH host key
CONFIG_NVS_ENCRYPTION=n

# Increase TCP MSS for better SSH throughput
CONFIG_LWIP_TCP_MSS=1436

# wolfSSH / wolfSSL need a large stack
CONFIG_LWIP_TCPIP_TASK_STACK_SIZE=4096

# Partition table
CONFIG_PARTITION_TABLE_SINGLE_APP_LARGE=y

# Console: route to native USB (USB-Serial-JTAG) – board has no UART bridge
CONFIG_ESP_CONSOLE_USB_SERIAL_JTAG=y
CONFIG_ESP_CONSOLE_SECONDARY_NONE=y
```
